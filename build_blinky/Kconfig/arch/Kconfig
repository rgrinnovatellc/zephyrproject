## build_blinky/Kconfig/arch/Kconfig
```kconfig
# Load Zephyr Arch Kconfig descriptions.
osource "/home/upgautam/CLionProjects/BlueFortACM2025/zephyrproject/zephyr/arch/rx/Kconfig"
osource "/home/upgautam/CLionProjects/BlueFortACM2025/zephyrproject/zephyr/arch/x86/Kconfig"
osource "/home/upgautam/CLionProjects/BlueFortACM2025/zephyrproject/zephyr/arch/xtensa/Kconfig"
osource "/home/upgautam/CLionProjects/BlueFortACM2025/zephyrproject/zephyr/arch/sparc/Kconfig"
osource "/home/upgautam/CLionProjects/BlueFortACM2025/zephyrproject/zephyr/arch/riscv/Kconfig"
osource "/home/upgautam/CLionProjects/BlueFortACM2025/zephyrproject/zephyr/arch/posix/Kconfig"
osource "/home/upgautam/CLionProjects/BlueFortACM2025/zephyrproject/zephyr/arch/mips/Kconfig"
osource "/home/upgautam/CLionProjects/BlueFortACM2025/zephyrproject/zephyr/arch/arm64/Kconfig"
osource "/home/upgautam/CLionProjects/BlueFortACM2025/zephyrproject/zephyr/arch/arm/Kconfig"
osource "/home/upgautam/CLionProjects/BlueFortACM2025/zephyrproject/zephyr/arch/arc/Kconfig"
```

## build_blinky/Kconfig/boards/Kconfig.nrf52840dk
```kconfig
# Load board Kconfig descriptions.
osource "/home/upgautam/CLionProjects/BlueFortACM2025/zephyrproject/zephyr/boards/nordic/nrf52840dk/Kconfig.nrf52840dk"
```

## build_blinky/Kconfig/boards/Kconfig.sysbuild
```kconfig
# Load Sysbuild board Kconfig descriptions.
osource "/home/upgautam/CLionProjects/BlueFortACM2025/zephyrproject/zephyr/boards/nordic/nrf52840dk/Kconfig.sysbuild"
```
